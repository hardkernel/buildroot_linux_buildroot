## package/aml_uboot_toolchain-codesourcery/Config.in
```kconfig
config BR2_PACKAGE_AML_UBOOT_TOOLCHAIN_CODESOURCERY
    bool "Amlogic uboot codesourcery toolchain"
    default n
    help
	amlogic m8 soc uboot compile toolchain, and 64bit soc bl30 compile toolchain
```

## package/aml_uboot_toolchain-gcc-linaro-aarch64/Config.in
```kconfig
config BR2_PACKAGE_AML_UBOOT_TOOLCHAIN_GCC_LINARO_AARCH64
    bool "aml_uboot_toolchain-gcc-linaro-aarch64"
    default y
    help
	amlogic 64bit soc uboot compile toolchain
```

## package/aml_uboot_toolchain-gcc-linaro-arm-none/Config.in
```kconfig
config BR2_PACKAGE_AML_UBOOT_TOOLCHAIN_GCC_LINARO_ARM_NONE
    bool "Amlogic uboot arm-none-eabi toolchain"
    default n
    help
	64bit soc bl30 compile toolchain
```

## package/amlogic/Config.in
```kconfig
menu "amlogic"

#Shared
    source "package/amlogic/aml_aaa/Config.in"
    source "package/amlogic/aml_util/Config.in"
    source "package/amlogic/aml_share/Config.in"
    source "package/amlogic/aml_customer/Config.in"
    source "package/amlogic/aml_usb_config/Config.in"
    source "package/amlogic/system_control/Config.in"
    source "package/amlogic/aml_commonlib/Config.in"

#Testing
    source "package/amlogic/test_tools/Config.in"
    source "package/amlogic/aml_pdm_mic_test/Config.in"
    source "package/amlogic/amlogic_test/Config.in"
    source "package/amlogic/vccktest/Config.in"


    source "package/amlogic/aml_thermal/Config.in"

    source "package/amlogic/slt/Config.in"

    source "package/amlogic/aml_ubootenv/Config.in"
    source "package/amlogic/aml_bootloader_message/Config.in"

#GFX
    source "package/amlogic/meson-mali/Config.in"
    source "package/amlogic/meson-display/Config.in"
    source "package/amlogic/aml_minigbm/Config.in"
    source "package/amlogic/aml_minigbmtest/Config.in"
    source "package/amlogic/drm-tests/Config.in"

#WiFi
    source "package/amlogic/aml_brcm_bsa/Config.in"
    source "package/amlogic/aml_cypress_bsa/Config.in"
    source "package/amlogic/bt_setup/Config.in"

#Audio
    source "package/amlogic/airplay2/Config.in"
    source "package/amlogic/aml_soundai/Config.in"
    source "package/amlogic/audioservice/Config.in"
    source "package/amlogic/aml_speaker_process/Config.in"
    source "package/amlogic/aml_audio_player/Config.in"
    source "package/amlogic/avs-sdk/Config.in"
    source "package/amlogic/assistant-sdk/Config.in"
    source "package/amlogic/librespot/Config.in"
    source "package/amlogic/librespot-sync/Config.in"


#Media
    source "package/amlogic/aml_libion/Config.in"
    source "package/amlogic/aml_libge2d/Config.in"
    source "package/amlogic/aml_libgdc/Config.in"
    source "package/amlogic/libvpcodec/Config.in"
    source "package/amlogic/libvphevcodec/Config.in"
    source "package/amlogic/libmultienc/Config.in"
    source "package/amlogic/media_modules/Config.in"
    source "../multimedia/Config.in"
    source "package/amlogic/aml_libs_nf/Config.in"

#IPC
    source "package/amlogic/arm_isp/Config.in"
    source "package/amlogic/ipc/Config.in"
    source "package/amlogic/aml_nn_detect_library/Config.in"

#TV
    source "package/amlogic/aml_tvserver/Config.in"
    source "package/amlogic/aml_dvb/Config.in"
    source "package/amlogic/aml_zvbi/Config.in"

#RTOS
    source "package/amlogic/aml_rtos/Config.in"
    source "package/amlogic/aml_dsp_util/Config.in"

#Browser
    source "package/amlogic/aml_launcher/Config.in"
    source "package/amlogic/aml_browser_toolchains/Config.in"
    source "package/amlogic/chromium/Config.in"
    source "package/amlogic/cobalt/Config.in"

#Crypto
    source "package/amlogic/aml_af_alg/Config.in"

    source "package/amlogic/aml_bdk/Config.in"
    source "package/amlogic/tdk/Config.in"
    source "package/amlogic/aml_hdcp/Config.in"
    source "package/amlogic/aml_provision/Config.in"

endmenu
```

## package/amlogic_test/Config.in
```kconfig
config BR2_PACKAGE_AMLOGIC_TEST
	bool "Amlogic Test"
	help
	    amlogic testing scripts and programs
```

## package/audioservice/Config.in
```kconfig
menuconfig BR2_PACKAGE_AUDIOSERVICE
	bool  "aml audioservice"
	select  BR2_PACKAGE_DBUS
	select  BR2_PACKAGE_DBUS_GLIB
	select  BR2_PACKAGE_CJSON
	select  BR2_PACKAGE_AML_HALAUDIO
	select  BR2_PACKAGE_RSYSLOG
	help
		demo app to show

if BR2_PACKAGE_AUDIOSERVICE

config BR2_PACKAGE_AUDIOSERVICE_PULSEAUDIO
	bool  "Enable audioservice with PulseAudio"
	select  BR2_PACKAGE_PULSEAUDIO
	select  BR2_PACKAGE_PULSEAUDIO_DAEMON
	default n

config BR2_PACKAGE_AUDIOSERVICE_FFMPEG
	bool  "Enable audioservice with ffmpeg"
	select  BR2_PACKAGE_FFMPEG
	default n

config BR2_PACKAGE_AUDIOSERVICE_ASR
	bool  "Enable audioservice client asr uartcmd"
	default n

config BR2_PACKAGE_AUDIOSERVICE_PYTHON
	bool  "Enable audioservice python client"
	select  BR2_PACKAGE_DBUS_PYTHON
	select  BR2_PACKAGE_PYTHON_PYEXPAT
	select  BR2_PACKAGE_PYTHON
	select  BR2_PACKAGE_PYTHON_GOBJECT
  default n

config BR2_PACKAGE_AUDIOSERVICE_S400
	bool  "Notify HalAudio configure 4 output channels"
	default n
	help
	  If this configure is not set, it means 8(5.1.2) output channels

endif
```

## package/brcmap6xxx/Config.in
```kconfig
config BR2_PACKAGE_BRCMAP6XXX
	bool "brcmap6xxx"
	depends on BR2_LINUX_KERNEL	
	help
	  brcmap6xxx driver

config BR2_PACKAGE_BRCMAP6XXX_GIT_VERSION
	string "brcmap6xxx branch"
	depends on BR2_PACKAGE_BRCMAP6XXX
	help
		Branch for brcmap6xxx	

config BR2_PACKAGE_BRCMAP6XXX_GIT_REPO_URL
	string "brcmap6xxx git"
	depends on BR2_PACKAGE_BRCMAP6XXX
	help
		brcmap6xxx git

config BR2_PACKAGE_BRCMAP6XXX_LOCAL
	bool "brcmap6xxx local"
	help
		brcmap6xxx local

config BR2_PACKAGE_BRCMAP6XXX_LOCAL_PATH
	string "brcmap6xxx local path"
	depends on BR2_PACKAGE_BRCMAP6XXX_LOCAL
	help
		brcmap6xxx local path

config BR2_PACKAGE_BRCMAP6XXX_STANDALONE
	bool "standalone kernel module"
	depends on BR2_PACKAGE_BRCMAP6XXX
	help
	  compile ko directly
```

## package/chromium/Config.in
```kconfig
config BR2_PACKAGE_CHROMIUM
	bool "Build Chromium package"
	select BR2_PACKAGE_PCIUTILS
	select BR2_PACKAGE_PULSEAUDIO
	select BR2_PACKAGE_KRB5
	select BR2_PACKAGE_LIBEXIF
	select BR2_PACKAGE_GCONF
	select BR2_PACKAGE_XBKCOMMON
	select BR2_PACKAGE_CUPS
	select BR2_PACKAGE_LIBNSS
	select BR2_PACKAGE_PANGO

#	select BR2_PACKAGE_CAIRO
#	select BR2_PACKAGE_FONTCONFIG
#	select BR2_PACKAGE_LIBCAP
#	select BR2_PACKAGE_NINJA
#	select BR2_PACKAGE_WAYLAND
#	select BR2_PACKAGE_OPENSSL

if BR2_PACKAGE_CHROMIUM

choice
	prompt "chromium compile mode choice"
	default BR2_PACKAGE_CHROMIUM_PREBUILT
	help
	  Select using prebuilt chromium bin or recompile chromium project.

config BR2_PACKAGE_CHROMIUM_COMPILE_ALL
	bool "recompile the total chromium"

config BR2_PACKAGE_CHROMIUM_PREBUILT
	bool "Use prebuilt chromium bin"

endchoice

endif
```

## package/cobalt/Config.in
```kconfig
config BR2_PACKAGE_COBALT
	bool "Build Cobalt package"
	select BR2_PACKAGE_PCIUTILS
	select BR2_PACKAGE_PULSEAUDIO
	select BR2_PACKAGE_KRB5
	select BR2_PACKAGE_LIBEXIF
	select BR2_PACKAGE_GCONF
	select BR2_PACKAGE_LIBXKBCOMMON
	select BR2_PACKAGE_CUPS
	select BR2_PACKAGE_LIBNSS
	select BR2_PACKAGE_PANGO
	select BR2_PACKAGE_LIBPLAYER
	select BR2_PACKAGE_WAYLAND
	select BR2_PACKAGE_WAYLAND_PROTOCOLS
	select BR2_PACKAGE_CA_CERTIFICATES

	help
	  cobalt browser

#	select BR2_PACKAGE_CAIRO
#	select BR2_PACKAGE_FONTCONFIG
#	select BR2_PACKAGE_LIBCAP
#	select BR2_PACKAGE_NINJA
#	select BR2_PACKAGE_OPENSSL

if BR2_PACKAGE_COBALT

choice
	prompt "cobalt compile mode choice"
	default BR2_PACKAGE_COBALT_PREBUILT
	help
	  Select using prebuilt cobalt binary package or recompile cobalt project.

config BR2_PACKAGE_COBALT_COMPILE_ALL
	bool "recompile the total cobalt"
    select BR2_PACKAGE_BROWSER_TOOLCHAIN_DEPOT_TOOLS
    select BR2_PACKAGE_BROWSER_TOOLCHAIN_BISON
    select BR2_PACKAGE_BROWSER_TOOLCHAIN_GCC_LINARO_AARCH64 if BR2_aarch64
    select BR2_PACKAGE_BROWSER_TOOLCHAIN_GCC_LINARO_ARMEABIHF if BR2_arm

config BR2_PACKAGE_COBALT_PREBUILT
	bool "Use prebuilt cobalt binary package"

endchoice

endif
```

## package/gconf/Config.in
```kconfig
config BR2_PACKAGE_GCONF
 bool "gconf"
 select BR2_PACKAGE_INTLTOOL
 select BR2_PACKAGE_DBUS_GLIB
 select BR2_PACKAGE_LIBXML2
 help
  GConf is a system for storing application preferences. It is intended
  for user preferences; *not* configuration of something like Apache,
  or arbitrary data storage.

  http://projects.gnome.org/gconf
```

## package/glmark2/Config.in
```kconfig
config BR2_PACKAGE_GLMARK2
	bool "glmark2"
	help
	  For benchmarking OpenGL-ES 2.  https://launchpad.net/glmark2
```

## package/ip-camera/Config.in
```kconfig
menu "ip camera"
source "package/ip-camera/onvif_prebuilt/Config.in"
source "package/ip-camera/onvif_srvd/Config.in"
source "package/ip-camera/onvif_wsdd/Config.in"
source "package/ip-camera/onvif_rtsp/Config.in"
source "package/ip-camera/ipc-property/Config.in"
source "package/ip-camera/ipc-webui/Config.in"
source "package/ip-camera/ipc_autocap/Config.in"
source "package/ip-camera/gst-amlion-allocator/Config.in"
source "package/ip-camera/gst-plugin-amlimgcap/Config.in"
source "package/ip-camera/gst-plugin-amloverlay/Config.in"
source "package/ip-camera/gst-plugin-amlvconv/Config.in"
source "package/ip-camera/gst-plugin-amlgdc/Config.in"
source "package/ip-camera/gst-plugin-amlvenc/Config.in"
source "package/ip-camera/gst-plugin-amlnn/Config.in"
source "package/ip-camera/ptz_control/Config.in"
config BR2_LINUX_KERNEL_IRCUT
	bool "amlogic ircut"
	default n
	help
	  amlogic ircut control
endmenu
```

## package/ip-camera/gst-plugin-amlfacenet/Config.in
```kconfig
config BR2_PACKAGE_GST_PLUGIN_AMLFACENET
	bool "gstream1 plugin facenet"
    select BR2_PACKAGE_SQLITE
    select BR2_PACKAGE_AML_NN_DETECT
	help
	  gstreamer 1.0 plugins
```

## package/ip-camera/gst-plugin-amlgdc/Config.in
```kconfig
config BR2_PACKAGE_GST_PLUGIN_AMLGDC
	bool "Amlogic gstream1 gdc plugin"
	select BR2_PACKAGE_AML_LIBGE2D
	select BR2_PACKAGE_AML_LIBGDC
	help
	  gstreamer 1.0 plugins
```

## package/ip-camera/gst-plugin-amlimgcap/Config.in
```kconfig
config BR2_PACKAGE_GST_PLUGIN_AMLIMGCAP
	bool "Amlogic gstream1 image capture plugin"
	select BR2_PACKAGE_LIBJPEG
	select BR2_PACKAGE_AML_LIBGE2D
	help
	  gstreamer 1.0 plugins
```

## package/ip-camera/gst-plugin-amlnn/Config.in
```kconfig
config BR2_PACKAGE_GST_PLUGIN_AMLNN
  bool "gstream1 plugin NN"
  select BR2_PACKAGE_AML_NN_DETECT
  select BR2_PACKAGE_SQLITE
	help
	  gstreamer 1.0 plugins
```

## package/ip-camera/gst-plugin-amloverlay/Config.in
```kconfig
config BR2_PACKAGE_GST_PLUGIN_AMLOVERLAY
	bool "Amlogic gstream1 text overlay plugin"
	help
	  gstreamer 1.0 plugins
```

## package/ip-camera/gst-plugin-amlvconv/Config.in
```kconfig
config BR2_PACKAGE_GST_PLUGIN_AMLVCONV
	bool "Amlogic gstream1 video convert/resize plugin"
	select BR2_PACKAGE_AML_LIBGE2D
	help
	  gstreamer 1.0 plugins
```

## package/ip-camera/gst-plugin-amlvenc/Config.in
```kconfig
config BR2_PACKAGE_GST_PLUGIN_AMLVENC
	bool "gstream1 plugin amlogic x264/x265 encoder"
	help
	  gstreamer 1.0 plugins
	select BR2_PACKAGE_LIBVPCODEC if !BR2_PACKAGE_GST_PLUGIN_AMLVENC_USE_MULTIENC
	select BR2_PACKAGE_LIBVPHEVCODEC if !BR2_PACKAGE_GST_PLUGIN_AMLVENC_USE_MULTIENC
	select BR2_PACKAGE_LIBMULTIENC if BR2_PACKAGE_GST_PLUGIN_AMLVENC_USE_MULTIENC

if BR2_PACKAGE_GST_PLUGIN_AMLVENC
config BR2_PACKAGE_GST_PLUGIN_AMLVENC_USE_MULTIENC
	bool "venc plugin with multi-encoder library"
	default n
	help
		check if use multi-encoder library
endif
```

## package/ip-camera/gst-plugin-amlx264enc/Config.in
```kconfig
config BR2_PACKAGE_GST_PLUGIN_AMLX264ENC
	bool "gstream1 plugin amlogic x264 encoder"
    select BR2_PACKAGE_LIBVPCODEC
	help
	  gstreamer 1.0 plugins
```

## package/ip-camera/gst-plugin-amlx265enc/Config.in
```kconfig
config BR2_PACKAGE_GST_PLUGIN_AMLX265ENC
	bool "gstream1 plugin amlogic x265 encoder"
    select BR2_PACKAGE_LIBVPHEVCODEC
	help
	  gstreamer 1.0 plugins
```

## package/ip-camera/gst-plugin-amlyoloface/Config.in
```kconfig
config BR2_PACKAGE_GST_PLUGIN_AMLYOLOFACE
	bool "gstream1 plugin face detection"
    select BR2_PACKAGE_LIBYOLOFACE
	help
	  gstreamer 1.0 plugins
```

## package/ip-camera/libvphevcodec/Config.in
```kconfig
config BR2_PACKAGE_LIBVPHEVCODEC
	bool "amlogic h265 video encoder"
	help
	  h265 video encoder library
```

## package/ip-camera/libyoloface/Config.in
```kconfig
config BR2_PACKAGE_LIBYOLOFACE
	bool "amlogic face detection"
	help
	  face detection library
```
