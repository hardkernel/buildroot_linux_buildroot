## toolchain/toolchain-external/Config.in
```kconfig
if BR2_TOOLCHAIN_EXTERNAL

comment "Toolchain External Options"

choice
	prompt "Toolchain"

comment "glibc toolchains only available with shared lib support"
	depends on BR2_STATIC_LIBS

# Kept toolchains sorted by architecture in order to use some toolchain
# as default choice

# Aarch64 (use Linaro toolchain by default)
source "toolchain/toolchain-external/toolchain-external-linaro-aarch64/Config.in"
source "toolchain/toolchain-external/toolchain-external-linaro-aarch64-4dot9/Config.in"
source "toolchain/toolchain-external/toolchain-external-linaro-aarch64-preinstalled/Config.in"

source "toolchain/toolchain-external/toolchain-external-codesourcery-aarch64/Config.in"

# ARC
source "toolchain/toolchain-external/toolchain-external-synopsys-arc/Config.in"

# ARM (use Linaro toolchain by default)
source "toolchain/toolchain-external/toolchain-external-linaro-arm/Config.in"
source "toolchain/toolchain-external/toolchain-external-linaro-arm-4dot9/Config.in"
source "toolchain/toolchain-external/toolchain-external-codesourcery-arm/Config.in"

# ARM big-endian
source "toolchain/toolchain-external/toolchain-external-linaro-armeb/Config.in"

# MIPS (use codesourcery toolchain by default)
source "toolchain/toolchain-external/toolchain-external-codesourcery-mips/Config.in"
source "toolchain/toolchain-external/toolchain-external-codescape-img-mips/Config.in"
source "toolchain/toolchain-external/toolchain-external-codescape-mti-mips/Config.in"

# NIOSII
source "toolchain/toolchain-external/toolchain-external-codesourcery-niosII/Config.in"

# SH4a
source "toolchain/toolchain-external/toolchain-external-codesourcery-sh/Config.in"

# x86/x86_64 (use amd64 toolchain by default for AMD64)
source "toolchain/toolchain-external/toolchain-external-codesourcery-amd64/Config.in"
source "toolchain/toolchain-external/toolchain-external-codesourcery-x86/Config.in"

# Kept last, so it remains the non-default choice, unless there isn't
# any available toolchain profile for the currently selected
# architecture.
source "toolchain/toolchain-external/toolchain-external-custom/Config.in"

endchoice

choice
        prompt "Kernel Toolchain"

comment "(e)glibc toolchains only available with shared lib support"
        depends on BR2_STATIC_LIBS
        depends on BR2_ARCH_IS_64

comment "Linaro toolchains available for Cortex-A + EABIhf"
        depends on BR2_arm || BR2_armeb
        depends on BR2_ARM_CPU_ARMV7A && BR2_ARM_EABIHF
        depends on BR2_STATIC_LIBS
        depends on BR2_KERNEL_64_USERLAND_32

# Note: we use the same symbol for both Linaro toolchains.
# Since they have different dependencies (the host), we can
# give them different prompts and different help texts.

# See note about Linaro ARM/ARMEB toolchains, above.
config BR2_TOOLCHAIN_EXTERNAL_LINARO_AARCH64_201409_U32K64
        bool "Linaro AArch64 14.09"
        depends on BR2_HOSTARCH = "x86_64" || BR2_HOSTARCH = "x86"
	depends on BR2_KERNEL_ARCH="arm64"
        depends on !BR2_STATIC_LIBS
        depends on BR2_ARCH_IS_64
        help
          Toolchain for the AArch64 architecture, from
          http://www.linaro.org/engineering/armv8/

config BR2_TOOLCHAIN_EXTERNAL_LINARO_AARCH64_U32K64
        bool "Linaro AArch64 2015.11"
        depends on BR2_HOSTARCH = "x86_64"
	depends on BR2_KERNEL_ARCH="arm64"
        depends on !BR2_STATIC_LIBS
        depends on BR2_ARCH_IS_64
        help
          Toolchain for the AArch64 architecture, from
          http://www.linaro.org/engineering/armv8/

config BR2_TOOLCHAIN_EXTERNAL_CODESOURCERY_AARCH64_U32K64
        bool "CodeSourcery AArch64 2014.05"
        depends on BR2_HOSTARCH = "x86_64" || BR2_HOSTARCH = "x86"
	depends on BR2_KERNEL_ARCH="arm64"
        depends on !BR2_STATIC_LIBS
        depends on BR2_ARCH_IS_64
        help
          Sourcery CodeBench toolchain for the AArch64 architecture,
          from Mentor Graphics. It uses gcc 4.8.3, binutils 2.24,
          glibc 2.18, gdb 7.7.50 and kernel headers 3.13.

endchoice

choice
	prompt "Toolchain origin"
	# Keep compatibility with old defconfig files that are using
	# custom toolchains, and which are therefore assuming that
	# "preinstalled" in the default choice.
	default BR2_TOOLCHAIN_EXTERNAL_PREINSTALLED if BR2_TOOLCHAIN_EXTERNAL_CUSTOM

config BR2_TOOLCHAIN_EXTERNAL_DOWNLOAD
	bool "Toolchain to be downloaded and installed"
	help
	  Select this option if you want Buildroot to download and install the
	  toolchain. If you have selected a custom toolchain, specify the URL
	  in BR2_TOOLCHAIN_EXTERNAL_URL.

config BR2_TOOLCHAIN_EXTERNAL_PREINSTALLED
	bool "Pre-installed toolchain"
	help
	  Select this option if you want to use a pre-installed toolchain.
	  Specify the path to this toolchain in BR2_TOOLCHAIN_EXTERNAL_PATH.

endchoice

config BR2_TOOLCHAIN_EXTERNAL_PATH
	string "Toolchain path"
	default "/path/to/toolchain/usr"
	depends on BR2_TOOLCHAIN_EXTERNAL_PREINSTALLED
	help
	  Path to where the external toolchain is installed.

config BR2_KERNEL_TOOLCHAIN_EXTERNAL_PATH
        string "Kernel Toolchain path"
        default "/path/to/toolchain/usr"
        depends on BR2_TOOLCHAIN_EXTERNAL_PREINSTALLED
        help
          Path to where the kernel external toolchain is installed.


config BR2_TOOLCHAIN_KERNEL_EXTERNAL_PREFIX
        string
        default "aarch64-linux-gnu"      if BR2_TOOLCHAIN_EXTERNAL_LINARO_AARCH64_U32K64
        default "aarch64-linux-gnu"      if BR2_TOOLCHAIN_EXTERNAL_LINARO_AARCH64_201409_U32K64
        default "aarch64-linux-gnu"      if BR2_TOOLCHAIN_EXTERNAL_CODESOURCERY_AARCH64_U32K64
	default "arm-linux-gnueabihf"	 if BR2_TOOLCHAIN_EXTERNAL_LINARO_ARM_201405

config BR2_TOOLCHAIN_EXTERNAL_GLIBC
	bool
	select BR2_TOOLCHAIN_USES_GLIBC

config BR2_TOOLCHAIN_EXTERNAL_UCLIBC
	bool
	select BR2_TOOLCHAIN_USES_UCLIBC

config BR2_TOOLCHAIN_EXTERNAL_MUSL
	bool
	select BR2_TOOLCHAIN_USES_MUSL
	# Compatibility headers: cdefs.h, queue.h
	select BR2_PACKAGE_MUSL_COMPAT_HEADERS

# Make sure the virtual-package infra checks the provider
config BR2_PACKAGE_HAS_TOOLCHAIN_EXTERNAL
	bool
	default y

config BR2_PACKAGE_PROVIDES_TOOLCHAIN_EXTERNAL
	string

config BR2_TOOLCHAIN_EXTERNAL_PREFIX
	string

# Kept toolchains sorted as in the choice above
# The toolchain Config.in.options must define
# BR2_PACKAGE_PROVIDES_TOOLCHAIN_EXTERNAL and BR2_TOOLCHAIN_EXTERNAL_PREFIX

# Aarch64
source "toolchain/toolchain-external/toolchain-external-linaro-aarch64/Config.in.options"
source "toolchain/toolchain-external/toolchain-external-linaro-aarch64-4dot9/Config.in.options"
source "toolchain/toolchain-external/toolchain-external-linaro-aarch64-preinstalled/Config.in.options"
source "toolchain/toolchain-external/toolchain-external-codesourcery-aarch64/Config.in.options"

# ARC
source "toolchain/toolchain-external/toolchain-external-synopsys-arc/Config.in.options"

# ARM
source "toolchain/toolchain-external/toolchain-external-linaro-arm/Config.in.options"
source "toolchain/toolchain-external/toolchain-external-linaro-arm-4dot9/Config.in.options"
source "toolchain/toolchain-external/toolchain-external-codesourcery-arm/Config.in.options"

# ARM big-endian
source "toolchain/toolchain-external/toolchain-external-linaro-armeb/Config.in.options"

# MIPS
source "toolchain/toolchain-external/toolchain-external-codesourcery-mips/Config.in.options"
source "toolchain/toolchain-external/toolchain-external-codescape-img-mips/Config.in.options"
source "toolchain/toolchain-external/toolchain-external-codescape-mti-mips/Config.in.options"

# NIOSII
source "toolchain/toolchain-external/toolchain-external-codesourcery-niosII/Config.in.options"

# SH4a
source "toolchain/toolchain-external/toolchain-external-codesourcery-sh/Config.in.options"

# x86/x86_64
source "toolchain/toolchain-external/toolchain-external-codesourcery-amd64/Config.in.options"
source "toolchain/toolchain-external/toolchain-external-codesourcery-x86/Config.in.options"

# Custom toolchains
source "toolchain/toolchain-external/toolchain-external-custom/Config.in.options"

config BR2_TOOLCHAIN_EXTERNAL_GDB_SERVER_COPY
	bool "Copy gdb server to the Target"
	depends on BR2_TOOLCHAIN_EXTERNAL
	help
	  Copy the gdbserver provided by the external toolchain to the
	  target.

endif # BR2_TOOLCHAIN_EXTERNAL
```
