## package/ip-camera/onvif_prebuilt/Config.in
```kconfig
config BR2_PACKAGE_ONVIF_PREBUILT
	bool "Apply/Generate ONVIF prebuilt"
	help
	  Apply/Generate ONVIF prebuilt package

if BR2_PACKAGE_ONVIF_PREBUILT

config BR2_PACKAGE_ONVIF_APPLY_PREBUILT
	bool "Apply ONVIF prebuilt"
    depends on !BR2_PACKAGE_ONVIF_SRVD

	select BR2_PACKAGE_PCIUTILS
	select BR2_PACKAGE_PULSEAUDIO
	select BR2_PACKAGE_KRB5
	select BR2_PACKAGE_LIBEXIF
	select BR2_PACKAGE_GCONF
	select BR2_PACKAGE_LIBXKBCOMMON
	select BR2_PACKAGE_CUPS
	select BR2_PACKAGE_LIBNSS
	select BR2_PACKAGE_PANGO
	select BR2_PACKAGE_LIBPLAYER
	select BR2_PACKAGE_WAYLAND
	select BR2_PACKAGE_WAYLAND_PROTOCOLS
	select BR2_PACKAGE_CA_CERTIFICATES
	select BR2_PACKAGE_GSTREAMER1
	select BR2_PACKAGE_GST1_PLUGINS_BASE_PLUGIN_ALSA
	select BR2_PACKAGE_GST1_PLUGINS_BASE_PLUGIN_AUDIOTESTSRC
	select BR2_PACKAGE_GST1_PLUGINS_BASE_PLUGIN_VIDEORATE
	select BR2_PACKAGE_GST1_PLUGINS_GOOD
	select BR2_PACKAGE_GST1_PLUGINS_GOOD_PLUGIN_V4L2
	select BR2_PACKAGE_GST1_PLUGINS_GOOD_PLUGIN_LAW
	select BR2_PACKAGE_GST1_PLUGINS_GOOD_PLUGIN_LAME

	help
	  Use ONVIF prebuilt package

config BR2_PACKAGE_ONVIF_GENERATE_PREBUILT
	bool "Generate ONVIF prebuilt"
    depends on BR2_PACKAGE_ONVIF_SRVD

	help
	  Generate ONVIF prebuilt package
endif
```

## package/ip-camera/onvif_rtsp/Config.in
```kconfig
config BR2_PACKAGE_ONVIF_RTSP
  bool "rtsp server for onvif"
  select BR2_PACKAGE_GSTREAMER1
  select BR2_PACKAGE_GST1_PLUGINS_BASE_PLUGIN_ALSA
  select BR2_PACKAGE_GST1_PLUGINS_BASE_PLUGIN_AUDIOTESTSRC
  select BR2_PACKAGE_GST1_PLUGINS_BASE_PLUGIN_VIDEORATE
  select BR2_PACKAGE_GST1_PLUGINS_GOOD
  select BR2_PACKAGE_GST1_PLUGINS_GOOD_PLUGIN_V4L2
  select BR2_PACKAGE_GST1_PLUGINS_GOOD_PLUGIN_LAW
  select BR2_PACKAGE_GST1_PLUGINS_GOOD_PLUGIN_LAME
  select BR2_PACKAGE_GST1_RTSP_SERVER
  select BR2_PACKAGE_GST_PLUGIN_AMLOVERLAY
  select BR2_PACKAGE_GST_PLUGIN_AMLVENC
  select BR2_PACKAGE_GST_PLUGIN_AMLYOLOFACE

  help
     rtsp server
```

## package/ip-camera/onvif_srvd/Config.in
```kconfig
config BR2_PACKAGE_ONVIF_SRVD
  bool "onvif server package"
  select BR2_PACKAGE_ONVIF_WSDD
  select BR2_PACKAGE_ONVIF_RTSP
  help
     onvif server
```

## package/ip-camera/rtspatt/Config.in
```kconfig
config BR2_PACKAGE_RTSPATT
  bool "rtsp-all-the-things package"
  select BR2_PACKAGE_GSTREAMER1
  select BR2_PACKAGE_GST1_PLUGINS_BASE_PLUGIN_VIDEORATE
  select BR2_PACKAGE_GST1_PLUGINS_GOOD
  select BR2_PACKAGE_GST1_PLUGINS_GOOD_PLUGIN_V4L2
  select BR2_PACKAGE_GST1_RTSP_SERVER
  select BR2_PACKAGE_GST_PLUGIN_AMLOVERLAY
  select BR2_PACKAGE_GST_PLUGIN_AMLVENC
  select BR2_PACKAGE_GST_PLUGIN_AMLYOLOFACE

  help
     rtsp server
```

## package/ledring/Config.in
```kconfig
config BR2_PACKAGE_LEDRING
    bool "LED ring light"
    help
        led ring light.
```

## package/librespot/Config.in
```kconfig
config BR2_PACKAGE_LIBRESPOT
	bool "librespot"
	help 
	     spotify connector call librespot
```

## package/libtwin/Config.in
```kconfig
config BR2_PACKAGE_LIBTWIN
	bool "libtwin"
	select BR2_PACKAGE_ZLIB
	depends on BR2_i386 || BR2_x86_64 || BR2_arm || BR2_armeb || \
		BR2_mips || BR2_mips64 || BR2_mipsel || BR2_mips64el || \
		BR2_powerpc || BR2_sh4 || BR2_sh4a || BR2_aarch64
	help

          https://git.kernel.org/pub/scm/linux/kernel/git/geoff/libtwin.git
```

## package/libvpcodec/Config.in
```kconfig
config BR2_PACKAGE_LIBVPCODEC
	bool "amlogic h264 video encoder"
	help
	  h264 video encoder library
```

## package/libvphevcodec/Config.in
```kconfig
config BR2_PACKAGE_LIBVPHEVCODEC
	bool "amlogic h265 video encoder"
	select BR2_PACKAGE_AML_LIBGE2D
	help
	  h265 video encoder library
```

## package/mali_examples/Config.in
```kconfig
config BR2_PACKAGE_MALI_EXAMPLES
	bool "mali examples"
    depends on BR2_PACKAGE_GPU
	help
	  Test examples for Mali OpenGL ES.
```

## package/mali_utility/Config.in
```kconfig
config BR2_PACKAGE_MALI_UTILITY
	bool "mali_utility"
    depends on BR2_PACKAGE_GPU
	help
	  Test utilities for Mali OpenGL ES.
```

## package/meson-mali/Config.in
```kconfig
config BR2_PACKAGE_MESON_MALI
	bool "amlogic mali opengl provider"
	select BR2_PACKAGE_HAS_LIBGLES
	select BR2_PACKAGE_HAS_LIBEGL
	help
		amlogic mali400 opengl driver.

		http://openlinux.amlogic.com

config BR2_PACKAGE_MESON_MALI_MODEL
	string "mali hw model"

config BR2_PACKAGE_MESON_MALI_VERSION
	string "mali opengl version"

choice
        bool "choose a mali egl"
        default BR2_PACKAGE_MESON_MALI_WAYLAND_FBDEV_EGL if !BR2_PACKAGE_WESTON_DRM
        default BR2_PACKAGE_MESON_MALI_WAYLAND_DRM_EGL if BR2_PACKAGE_WESTON_DRM
        help
                choose wayland_fbdev or wayland_drm, or fbdev

config BR2_PACKAGE_MESON_MALI_WAYLAND_FBDEV_EGL
        bool "wayland with fbdev backend"
        select BR2_PACKAGE_HAS_LIBEGL_WAYLAND
        help
                support wayland api for app, backend is fbdev

config BR2_PACKAGE_MESON_MALI_WAYLAND_DRM_EGL
        bool "wayland with drm backend"
        select BR2_PACKAGE_HAS_LIBEGL_WAYLAND
        help
                support wayland api for app, backend is drm

config BR2_PACKAGE_MESON_MALI_FBDEV_EGL
        bool "fbdev"
        help
                support fbdev for app to control

endchoice

config BR2_PACKAGE_PROVIDES_LIBEGL
	default "meson-mali" if BR2_PACKAGE_MESON_MALI

config BR2_PACKAGE_PROVIDES_LIBGLES
	default "meson-mali" if BR2_PACKAGE_MESON_MALI
```

## package/nghttp2/Config.in
```kconfig
config BR2_PACKAGE_NGHTTP2
	bool "nghttp2"
	help
		This is an implementation of the Hypertext Transfer Protocol version 2 in C.
		The framing layer of HTTP/2 is implemented as a reusable C library. On top of
	   	that, we have implemented anHTTP/2 client, server and proxy. We have also
		developed load test andbenchmarking tools for HTTP/2 and SPDY.
```

## package/opengl/Config.in
```kconfig
source "package/opengl/libegl/Config.in"
source "package/opengl/libgles/Config.in"
source "package/opengl/libopenvg/Config.in"
source "package/opengl/libopenmax/Config.in"

config BR2_PACKAGE_OPENGL
	bool "opengl"
	select BR2_PACKAGE_HAS_OPENGL_EGL
	select BR2_PACKAGE_HAS_OPENGL_ES
	help
	  amlogic mali400 opengl driver.

	  http://openlinux.amlogic.com

config BR2_PACKAGE_OPENGL_MALI_VERSION
    string "mali version"
```

## package/provision/Config.in
```kconfig
config BR2_PACKAGE_PROVISION
	bool "provision ca and ta"
	help
	  provision ca and ta
```

## package/qt5/qt5wayland/Config.in
```kconfig
config BR2_PACKAGE_QT5WAYLAND
	bool "qt5wayland"
	select BR2_PACKAGE_LIBXKBCOMMON
	select BR2_PACKAGE_XKEYBOARD_CONFIG
	depends on BR2_PACKAGE_WAYLAND && BR2_PACKAGE_HAS_LIBEGL_WAYLAND
	default y if BR2_PACKAGE_WAYLAND && BR2_PACKAGE_HAS_LIBEGL_WAYLAND
	help
	  Qt is a cross-platform application and UI framework for
	  developers using C++.

	  This package corresponds to the qt5wayland module.

	  http://qt.io
```

## package/ump_userspace_drv/Config.in
```kconfig
config BR2_PACKAGE_UMP_USERSPACE_DRV
        bool "ump user space driver"
        help
          ump user space driver from arm.
```

## package/widevine-ce-cdm/Config.in
```kconfig
config BR2_PACKAGE_WIDEVINE_CE_CDM
	bool "widevine ce cdm"
    default n
    select BR2_PACKAGE_BROWSER_TOOLCHAIN_DEPOT_TOOLS
    select BR2_PACKAGE_WIDEVINE_BIN
    select BR2_PACKAGE_WIDEVINE_BIN_VERSION_14

config BR2_PACKAGE_WIDEVINE_CE_CDM_PREBUILD
	bool "use prebuild widevine ce cdm"
    default n
    depends on BR2_PACKAGE_WIDEVINE_CE_CDM

config BR2_PACKAGE_WIDEVINE_CE_CDM_REPO
    string "widevine ce cdm url"
    depends on BR2_PACKAGE_WIDEVINE_CE_CDM && !BR2_PACKAGE_WIDEVINE_CE_CDM_PREBUILD

config BR2_PACKAGE_WIDEVINE_CE_CDM_UPDATE_PREBUILD
	bool "update widevine ce cdm prebuild"
    default n
    depends on BR2_PACKAGE_WIDEVINE_CE_CDM && !BR2_PACKAGE_WIDEVINE_CE_CDM_PREBUILD
```

## package/x11r7/xdriver_xf86-video-fbturbo/Config.in
```kconfig
config BR2_PACKAGE_XDRIVER_XF86_VIDEO_FBTURBO
	bool "xf86-video-fbturbo"
	select BR2_PACKAGE_XPROTO_FONTSPROTO
	select BR2_PACKAGE_XPROTO_RANDRPROTO
	select BR2_PACKAGE_XPROTO_RENDERPROTO
	select BR2_PACKAGE_XPROTO_VIDEOPROTO
	select BR2_PACKAGE_XPROTO_XPROTO
	help
	  ARM Allwinner-based framebuffer device
```

## toolchain/Config.in
```kconfig
menu "Toolchain"

# Invisible option that makes sure the toolchain package always gets
# built
choice
        prompt "Kernel Toolchain"

comment "(e)glibc toolchains only available with shared lib support"
        depends on BR2_STATIC_LIBS
        depends on BR2_ARCH_IS_64

comment "Linaro toolchains available for Cortex-A + EABIhf"
        depends on BR2_arm || BR2_armeb
        depends on BR2_ARM_CPU_ARMV7A && BR2_ARM_EABIHF
        depends on BR2_STATIC_LIBS
        depends on BR2_KERNEL_64_USERLAND_32

# Note: we use the same symbol for both Linaro toolchains.
# Since they have different dependencies (the host), we can
# give them different prompts and different help texts.

# See note about Linaro ARM/ARMEB toolchains, above.
config BR2_KERNEL_TOOLCHAIN_LINARO_AARCH64_201408
        bool "Linaro AArch64 14.08"
        depends on BR2_HOSTARCH = "x86_64" || BR2_HOSTARCH = "x86"
	depends on BR2_KERNEL_ARCH="arm64"
        depends on !BR2_STATIC_LIBS
        help
          Toolchain for the AArch64 architecture, from
          http://www.linaro.org/engineering/armv8/

config BR2_KERNEL_TOOLCHAIN_LINARO_AARCH64_201702
        bool "Linaro AArch64 2017.02"
        depends on BR2_HOSTARCH = "x86_64"
	depends on BR2_KERNEL_ARCH="arm64"
        depends on !BR2_STATIC_LIBS
        help
          Toolchain for the AArch64 architecture, from
          http://www.linaro.org/engineering/armv8/

config BR2_KERNEL_TOOLCHAIN_CODESOURCERY_AARCH64
        bool "CodeSourcery AArch64 2014.05"
        depends on BR2_HOSTARCH = "x86_64" || BR2_HOSTARCH = "x86"
	depends on BR2_KERNEL_ARCH="arm64"
        depends on !BR2_STATIC_LIBS
        help
          Sourcery CodeBench toolchain for the AArch64 architecture,
          from Mentor Graphics. It uses gcc 4.8.3, binutils 2.24,
          glibc 2.18, gdb 7.7.50 and kernel headers 3.13.

config BR2_KERNEL_TOOLCHAIN_LINARO_ARM_201405
        bool "Linaro arm 14.05"
        depends on BR2_HOSTARCH = "x86_64" || BR2_HOSTARCH = "x86"
	depends on BR2_KERNEL_ARCH="arm"
        depends on !BR2_STATIC_LIBS
        help
          Toolchain for the AArch64 architecture, from
          http://www.linaro.org/engineering/armv8/

config BR2_KERNEL_TOOLCHAIN_LINARO_ARM_201702
        bool "Linaro arm 17.02"
        depends on BR2_HOSTARCH = "x86_64" || BR2_HOSTARCH = "x86"
	depends on BR2_KERNEL_ARCH="arm64"
        depends on !BR2_STATIC_LIBS
        help
          Toolchain for the AArch64 architecture, from
          http://www.linaro.org/engineering/armv8/

endchoice

config BR2_KERNEL_TOOLCHAIN_PATH
        string "Kernel Toolchain path"
        default "/path/to/toolchain/usr"
        help
          Path to where the kernel external toolchain is installed.


config BR2_KERNEL_TOOLCHAIN_PREFIX
        string
        default "aarch64-linux-gnu"      if BR2_KERNEL_TOOLCHAIN_LINARO_AARCH64_201408
        default "aarch64-linux-gnu"      if BR2_KERNEL_TOOLCHAIN_LINARO_AARCH64_201702
        default "aarch64-linux-gnu"      if BR2_KERNEL_TOOLCHAIN_CODESOURCERY_AARCH64
        default "arm-linux-gnueabihf"	 if BR2_KERNEL_TOOLCHAIN_LINARO_ARM_201405
        default "arm-linux-gnueabihf"    if BR2_KERNEL_TOOLCHAIN_LINARO_ARM_201702

config BR2_TOOLCHAIN
	bool
	default y

# Should be selected for glibc or eglibc
config BR2_TOOLCHAIN_USES_GLIBC
	bool
	select BR2_USE_WCHAR
	select BR2_ENABLE_LOCALE
	select BR2_TOOLCHAIN_HAS_THREADS
	select BR2_TOOLCHAIN_HAS_THREADS_DEBUG
	select BR2_TOOLCHAIN_HAS_THREADS_NPTL
	select BR2_TOOLCHAIN_HAS_SHADOW_PASSWORDS
	select BR2_TOOLCHAIN_SUPPORTS_PIE

config BR2_TOOLCHAIN_USES_UCLIBC
	bool
	select BR2_TOOLCHAIN_SUPPORTS_PIE if !BR2_m68k && !BR2_microblaze && !BR2_STATIC_LIBS

config BR2_TOOLCHAIN_USES_MUSL
	bool
	select BR2_USE_WCHAR
	select BR2_ENABLE_LOCALE
	select BR2_TOOLCHAIN_HAS_THREADS
	select BR2_TOOLCHAIN_HAS_THREADS_DEBUG
	select BR2_TOOLCHAIN_HAS_THREADS_NPTL
	select BR2_TOOLCHAIN_SUPPORTS_PIE

choice
	prompt "Toolchain type"
	help
	  Select whether to use the toolchain provided by buildroot
	  or an external toolchain.

	  Some vendors provide toolchains in binary form, some in
	  source form.

config BR2_TOOLCHAIN_BUILDROOT
	bool "Buildroot toolchain"
	select BR2_TOOLCHAIN_HAS_SHADOW_PASSWORDS
	depends on !BR2_bf606
	depends on !BR2_bf607
	depends on !BR2_bf608
	depends on !BR2_bf609

config BR2_TOOLCHAIN_EXTERNAL
	bool "External toolchain"
	help
	  Select if you want to use an existing cross-compiling
	  toolchain. Buildroot can either download automatically a
	  toolchain, or use an already installed toolchain.

endchoice

source "toolchain/toolchain-buildroot/Config.in"
source "toolchain/toolchain-external/Config.in"
source "toolchain/toolchain-common.in"

endmenu
```
