## boot/petitboot/Config.in
```kconfig
config BR2_TARGET_PETITBOOT
	bool "petitboot"
	select BR2_PACKAGE_LVM2
	select BR2_PACKAGE_LVM2_STANDARD_INSTALL
	help

           https://github.com/open-power/petitboot.git
```

## boot/uboot-parser/Config.in
```kconfig
config BR2_TARGET_UBOOT_PARSER
	bool "uboot-parser"
	help
           The command line to parse 'boot.ini' to grab the boot configuration
```

## configs/meson8b_m201_release_defconfig
```kconfig
# Mirrors and Download locations
BR2_BACKUP_SITE="http://openlinux.amlogic.com:8000/download/GPL_code_release/ThirdParty"
# Architecture
BR2_arm=y
BR2_cortex_a5=y
BR2_ARM_ENABLE_NEON=y
BR2_ARM_FPU_NEON=y
BR2_ARM_KERNEL_32=y
BR2_DEPRECATED=y
BR2_TOOLCHAIN_BUILDROOT=y
BR2_TOOLCHAIN_BUILDROOT_GLIBC=y
BR2_KERNEL_HEADERS_3_10=y
BR2_GLIBC_VERSION_2_23=y
BR2_BINUTILS_VERSION_2_27_X=y
BR2_GCC_VERSION_6_X=y
BR2_TOOLCHAIN_BUILDROOT_CXX=y
BR2_KERNEL_TOOLCHAIN_PATH="$(TOPDIR)/../toolchain/gcc/linux-x86/arm/gcc-linaro-arm-linux-gnueabihf-4.9"
BR2_TOOLCHAIN_EXTERNAL_LINARO_ARM_4DOT9_201405_PREINSTALLED=y
BR2_ARM_EABIHF=y
BR2_ARM_ENABLE_VFP=y
#BR2_ENABLE_DEBUG=y
BR2_PACKAGE_HOST_GDB=y
#BR2_PACKAGE_AML_CUSTOMER=y
#BR2_PACKAGE_AML_CUSTOMER_VERSION="2015-01-15-2bfa06ee5e"
#BR2_PACKAGE_AML_CUSTOMER_GIT_URL="http://openlinux.amlogic.com:8000/download/ARM/customer"
BR2_PACKAGE_ALSA_UTILS=y
BR2_PACKAGE_BUSYBOX_SHOW_OTHERS=y
#
# ALSA utils selection
#
BR2_PACKAGE_ALSA_UTILS_ALSACTL=y
BR2_PACKAGE_ALSA_UTILS_ALSACONF=y
BR2_PACKAGE_ALSA_UTILS_AMIXER=y
BR2_PACKAGE_ALSA_UTILS_ALSAMIXER=y
BR2_PACKAGE_ALSA_UTILS_APLAY=y
# Gstreamer 1
#
BR2_PACKAGE_GSTREAMER1=y
BR2_PACKAGE_GSTREAMER1_PARSE=y
BR2_PACKAGE_GSTREAMER1_TRACE=y
BR2_PACKAGE_GSTREAMER1_GST_DEBUG=y
BR2_PACKAGE_GSTREAMER1_PLUGIN_REGISTRY=y
BR2_PACKAGE_GSTREAMER1_INSTALL_TOOLS=y
BR2_PACKAGE_GST1_PLUGINS_BASE=y

#
# dependency-less plugins
#
BR2_PACKAGE_GST1_PLUGINS_BASE_PLUGIN_APP=y
BR2_PACKAGE_GST1_PLUGINS_BASE_PLUGIN_AUDIOCONVERT=y
BR2_PACKAGE_GST1_PLUGINS_BASE_PLUGIN_VIDEOCONVERT=y
BR2_PACKAGE_GST1_PLUGINS_BASE_PLUGIN_PLAYBACK=y
BR2_PACKAGE_GST1_PLUGINS_BASE_PLUGIN_AUDIORESAMPLE=y
BR2_PACKAGE_GST1_PLUGINS_BASE_PLUGIN_SUBPARSE=y
BR2_PACKAGE_GST1_PLUGINS_BASE_PLUGIN_TYPEFIND=y
BR2_PACKAGE_GST1_PLUGINS_BASE_PLUGIN_VIDEOSCALE=y
BR2_PACKAGE_GST1_PLUGINS_BASE_PLUGIN_VOLUME=y

#
# plugins with external dependencies
#
BR2_PACKAGE_GST1_PLUGINS_BASE_PLUGIN_OGG=y
BR2_PACKAGE_GST1_PLUGINS_GOOD=y
BR2_PACKAGE_GST1_PLUGINS_GOOD_ZLIB=y

#
# dependency-less plugins
#
BR2_PACKAGE_GST1_PLUGINS_GOOD_PLUGIN_ALPHA=y
BR2_PACKAGE_GST1_PLUGINS_GOOD_PLUGIN_APETAG=y
BR2_PACKAGE_GST1_PLUGINS_GOOD_PLUGIN_AUDIOPARSERS=y
BR2_PACKAGE_GST1_PLUGINS_GOOD_PLUGIN_AUPARSE=y
BR2_PACKAGE_GST1_PLUGINS_GOOD_PLUGIN_AUTODETECT=y
BR2_PACKAGE_GST1_PLUGINS_GOOD_PLUGIN_AVI=y
BR2_PACKAGE_GST1_PLUGINS_GOOD_PLUGIN_DEINTERLACE=y
BR2_PACKAGE_GST1_PLUGINS_GOOD_PLUGIN_FLV=y
BR2_PACKAGE_GST1_PLUGINS_GOOD_PLUGIN_ICYDEMUX=y
BR2_PACKAGE_GST1_PLUGINS_GOOD_PLUGIN_ID3DEMUX=y
BR2_PACKAGE_GST1_PLUGINS_GOOD_PLUGIN_ISOMP4=y
BR2_PACKAGE_GST1_PLUGINS_GOOD_PLUGIN_MATROSKA=y
BR2_PACKAGE_GST1_PLUGINS_GOOD_PLUGIN_RTP=y
BR2_PACKAGE_GST1_PLUGINS_GOOD_PLUGIN_RTPMANAGER=y
BR2_PACKAGE_GST1_PLUGINS_GOOD_PLUGIN_RTSP=y
BR2_PACKAGE_GST1_PLUGINS_GOOD_PLUGIN_UDP=y
BR2_PACKAGE_GST1_PLUGINS_GOOD_PLUGIN_VIDEOFILTER=y

#
# plugins with external dependencies
#
BR2_PACKAGE_GST1_PLUGINS_GOOD_PLUGIN_SOUPHTTPSRC=y
BR2_PACKAGE_GST1_PLUGINS_GOOD_PLUGIN_TAGLIB=y
BR2_PACKAGE_GST1_PLUGINS_BAD=y

#
# dependency-less plugins
#
BR2_PACKAGE_GST1_PLUGINS_BAD_PLUGIN_AIFF=y
BR2_PACKAGE_GST1_PLUGINS_BAD_PLUGIN_AUTOCONVERT=y
BR2_PACKAGE_GST1_PLUGINS_BAD_PLUGIN_CDXAPARSE=y
BR2_PACKAGE_GST1_PLUGINS_BAD_PLUGIN_HDVPARSE=y
BR2_PACKAGE_GST1_PLUGINS_BAD_PLUGIN_ID3TAG=y
BR2_PACKAGE_GST1_PLUGINS_BAD_PLUGIN_INTERLACE=y
BR2_PACKAGE_GST1_PLUGINS_BAD_PLUGIN_IVFPARSE=y
BR2_PACKAGE_GST1_PLUGINS_BAD_PLUGIN_MPEGDEMUX=y
BR2_PACKAGE_GST1_PLUGINS_BAD_PLUGIN_MPEGTSDEMUX=y
BR2_PACKAGE_GST1_PLUGINS_BAD_PLUGIN_NUVDEMUX=y
BR2_PACKAGE_GST1_PLUGINS_BAD_PLUGIN_PATCHDETECT=y
BR2_PACKAGE_GST1_PLUGINS_BAD_PLUGIN_PCAPPARSE=y
BR2_PACKAGE_GST1_PLUGINS_BAD_PLUGIN_RAWPARSE=y
BR2_PACKAGE_GST1_PLUGINS_BAD_PLUGIN_SMOOTH=y
BR2_PACKAGE_GST1_PLUGINS_BAD_PLUGIN_VIDEOFILTERS=y
BR2_PACKAGE_GST1_PLUGINS_BAD_PLUGIN_VIDEOPARSERS=y

#
# plugins with external dependencies
#
BR2_PACKAGE_GST1_PLUGINS_BAD_PLUGIN_BZ2=y
BR2_PACKAGE_GST1_PLUGINS_BAD_PLUGIN_CURL=y
BR2_PACKAGE_GST1_PLUGINS_BAD_PLUGIN_DASH=y
BR2_PACKAGE_GST1_PLUGINS_BAD_PLUGIN_DIRECTFB=y
#
# gl needs the gst1-plugins-bad opengl library
#
BR2_PACKAGE_GST1_PLUGINS_BAD_PLUGIN_HLS=y
BR2_PACKAGE_GST1_PLUGINS_UGLY=y

#
# dependency-less plugins
#
BR2_PACKAGE_GST1_PLUGINS_UGLY_PLUGIN_ASFDEMUX=y
BR2_PACKAGE_GST1_PLUGINS_UGLY_PLUGIN_REALMEDIA=y

#
# plugins with external dependencies (there may be more available)
#
BR2_PACKAGE_GST1_VALIDATE=y

#
# gst-omx requires a OpenMAX implementation
#
BR2_PACKAGE_KODI_ARCH_SUPPORTS=y
BR2_PACKAGE_KODI_EGL_GLES=y
BR2_PACKAGE_GST_AML_PLUGINS1=y
BR2_PACKAGE_WAVPACK=y

#
# Audio/Sound
#
BR2_PACKAGE_ALSA_LIB=y

#
# ALSA lib selection
#
BR2_PACKAGE_ALSA_LIB_DEVDIR="/dev/snd"
BR2_PACKAGE_ALSA_LIB_PCM_PLUGINS="all"
BR2_PACKAGE_ALSA_LIB_CTL_PLUGINS="all"
BR2_PACKAGE_ALSA_LIB_ALOAD=y
BR2_PACKAGE_ALSA_LIB_MIXER=y
BR2_PACKAGE_ALSA_LIB_PCM=y
BR2_PACKAGE_ALSA_LIB_RAWMIDI=y
BR2_PACKAGE_ALSA_LIB_HWDEP=y
BR2_PACKAGE_ALSA_LIB_SEQ=y
BR2_PACKAGE_ALSA_LIB_ALISP=y
BR2_PACKAGE_ALSA_LIB_OLD_SYMBOLS=y
BR2_PACKAGE_LIBID3TAG=y
BR2_PACKAGE_LIBMAD=y
BR2_PACKAGE_LIBMAD_OPTIMIZATION_DEFAULT=y
BR2_PACKAGE_LIBMAD_ASO=y
BR2_PACKAGE_LIBPLAYER=y
BR2_PACKAGE_GDB=y
BR2_PACKAGE_GDB_SERVER=y
BR2_PACKAGE_GDB_DEBUGGER=y
BR2_PACKAGE_DIRECTFB=y
BR2_PACKAGE_E2FSPROGS=y
BR2_PACKAGE_FBDUMP=y
BR2_PACKAGE_FBGRAB=y
BR2_PACKAGE_FBSET=y
BR2_PACKAGE_FBTERM=y
BR2_PACKAGE_FB_TEST_APP=y
BR2_PACKAGE_UTIL_LINUX_BINARIES=y
# other GUIs
BR2_PACKAGE_QT5=y
BR2_PACKAGE_QT5BASE=y
BR2_PACKAGE_QT5BASE_LICENSE_APPROVED=y
BR2_PACKAGE_QT5BASE_NETWORK=y
BR2_PACKAGE_QT5BASE_CONCURRENT=y
BR2_PACKAGE_QT5BASE_SQL=y
BR2_PACKAGE_QT5BASE_SQLITE_SYSTEM=y
BR2_PACKAGE_QT5BASE_TEST=y
BR2_PACKAGE_QT5BASE_XML=y
BR2_PACKAGE_QT5BASE_GUI=y
BR2_PACKAGE_QT5BASE_WIDGETS=y
BR2_PACKAGE_QT5BASE_LINUXFB=y
BR2_PACKAGE_QT5BASE_DIRECTFB=y

#
# X.org XCB backend available if X.org is enabled
#
BR2_PACKAGE_QT5BASE_EGLFS=y
BR2_PACKAGE_QT5BASE_PRINTSUPPORT=y
BR2_PACKAGE_QT5BASE_FONTCONFIG=y
BR2_PACKAGE_QT5BASE_GIF=y
BR2_PACKAGE_QT5BASE_JPEG=y
BR2_PACKAGE_QT5BASE_PNG=y
BR2_PACKAGE_QT5BASE_DBUS=y
BR2_PACKAGE_QT5BASE_ICU=y
BR2_PACKAGE_QT5BASE_TSLIB=y
BR2_PACKAGE_QT5DECLARATIVE=y
BR2_PACKAGE_QT5GRAPHICALEFFECTS=y
BR2_PACKAGE_QT5IMAGEFORMATS=y
BR2_PACKAGE_QT5MULTIMEDIA=y
BR2_PACKAGE_QT5QUICKCONTROLS=y
BR2_PACKAGE_QT5SCRIPT=y
BR2_PACKAGE_QT5SENSORS=y
BR2_PACKAGE_QT5SERIALPORT=y
BR2_PACKAGE_QT5SVG=y
BR2_PACKAGE_QT5WEBKIT=y
BR2_PACKAGE_QT5XMLPATTERNS=y
BR2_PACKAGE_QT5BASE_EXAMPLES=y
BR2_PACKAGE_OPENSSL=y
BR2_PACKAGE_SQLITE=y
BR2_PACKAGE_CAIRO_SCRIPT=y
BR2_PACKAGE_LIBJPEG=y
BR2_PACKAGE_JPEG=y
BR2_PACKAGE_MESON_MALI=y
BR2_PACKAGE_TSLIB=y
BR2_PACKAGE_NCURSES=y
BR2_PACKAGE_NCURSES_TARGET_PANEL=y
BR2_PACKAGE_NCURSES_TARGET_FORM=y
BR2_PACKAGE_NCURSES_TARGET_MENU=y
BR2_PACKAGE_KMOD=y
BR2_PACKAGE_PANGO=y
BR2_PACKAGE_REMOTECFG=y
BR2_PACKAGE_LIBCARES=y
BR2_PACKAGE_LIBCURL=y
BR2_PACKAGE_BOOST=y
BR2_PACKAGE_LIBEVENT=y
BR2_PACKAGE_ICU=y
BR2_PACKAGE_CJSON=y
BR2_PACKAGE_LIBXSLT=y
BR2_PACKAGE_DHCPCD=y
BR2_PACKAGE_DNSMASQ=y
BR2_PACKAGE_DNSMASQ_TFTP=n
BR2_PACKAGE_DNSMASQ_DHCP=n
BR2_PACKAGE_IW=y
BR2_PACKAGE_WPA_SUPPLICANT=y
BR2_PACKAGE_WPA_SUPPLICANT_CLI=y
BR2_PACKAGE_LIBNL=y
BR2_PACKAGE_VIM=y
BR2_PACKAGE_NTFS_3G=y
BR2_TARGET_ROOTFS_CPIO=y
BR2_TARGET_ROOTFS_CPIO_GZIP=y
BR2_TARGET_ROOTFS_CPIO_UIMAGE=y
BR2_TARGET_ROOTFS_INITRAMFS_LIST="board/amlogic/meson8b_m201/initramfs/ramfslist-hf"
BR2_TARGET_ROOTFS_EXT2=y
BR2_TARGET_ROOTFS_EXT2_4=y
BR2_TARGET_ROOTFS_TAR_GZIP=y
BR2_ROOTFS_DEVICE_CREATION_DYNAMIC_EUDEV=y
BR2_ROOTFS_COMMON_OVERLAY="board/amlogic/common/rootfs/rootfs-310/"
BR2_ROOTFS_OVERLAY="board/amlogic/meson8b_m201/rootfs/"
BR2_ROOTFS_UPGRADE_DIR="board/amlogic/common/upgrade/upgrade-m8/"
BR2_LINUX_KERNEL=y
BR2_LINUX_KERNEL_UIMAGE=y
BR2_LINUX_KERNEL_CUSTOM_LOCAL_VERSION_VALUE="amlogic-3.10-dev"
BR2_LINUX_KERNEL_CUSTOM_LOCAL=y
BR2_LINUX_KERNEL_CUSTOM_LOCAL_PATH="$(TOPDIR)/../kernel/aml-3.10"
BR2_LINUX_KERNEL_DEFCONFIG="meson8b"
BR2_TARGET_BOARD_PLATFORM="meson8"
BR2_LINUX_KERNEL_PATCH="linux/amlogic-3.10"
BR2_LINUX_KERNEL_DTS_SUPPORT=y
BR2_LINUX_KERNEL_USE_INTREE_DTS=y
BR2_LINUX_KERNEL_INTREE_DTS_NAME="meson8b_m201_1G_buildroot"
BR2_LINUX_KERNEL_AMLOGIC_DTD=y
BR2_LINUX_KERNEL_AMLOGIC_DTD_STRIP=y
BR2_LINUX_KERNEL_ANDROID_FORMAT=y
BR2_PACKAGE_GPU=y
BR2_PACKAGE_GPU_LOCAL=y
BR2_PACKAGE_GPU_VERSION="r7p0"
BR2_PACKAGE_GPU_LOCAL_PATH="$(TOPDIR)/../hardware/aml-3.14/arm/gpu"
BR2_PACKAGE_WIFI_FW=y
BR2_PACKAGE_WIFI_FW_LOCAL=y
BR2_PACKAGE_WIFI_CUSTOM_GIT_VERSION="kk-amlogic"
BR2_PACKAGE_WIFI_FW_CUSTOM_LOCAL_PATH="$(TOPDIR)/../hardware/aml-3.10/amlogic/wifi"
BR2_PACKAGE_WIFI_FW_WIFI_MODULE="AP6210"
#BR2_PACKAGE_RTK8188EU=y
#BR2_PACKAGE_RTK8188EU_LOCAL=y
#BR2_PACKAGE_RTK8188EU_GIT_VERSION="8188eu"
#BR2_PACKAGE_RTK8188EU_LOCAL_PATH="$(TOPDIR)/../hardware/aml-3.10/wifi/realtek/drivers/8188eu"
#BR2_PACKAGE_RTK8192CU=y
#BR2_PACKAGE_RTK8192CU_LOCAL=y
#BR2_PACKAGE_RTK8192CU_GIT_VERSION="8192cu"
#BR2_PACKAGE_RTK8192CU_LOCAL_PATH="$(TOPDIR)/../hardware/aml-3.10/wifi/realtek/drivers/8192cu"
#BR2_PACKAGE_RTK8192DU=y
#BR2_PACKAGE_RTK8192DU_LOCAL=y
#BR2_PACKAGE_RTK8192DU_GIT_VERSION="8192du"
#BR2_PACKAGE_RTK8192DU_LOCAL_PATH="$(TOPDIR)/../hardware/aml-3.10/wifi/realtek/drivers/8192du"
#BR2_PACKAGE_RTK8192EU=y
#BR2_PACKAGE_RTK8192EU_LOCAL=y
#BR2_PACKAGE_RTK8192EU_GIT_VERSION="8192eu"
#BR2_PACKAGE_RTK8192EU_LOCAL_PATH="$(TOPDIR)/../hardware/aml-3.10/wifi/realtek/drivers/8192eu"
#BR2_PACKAGE_RTK8189ES=y
#BR2_PACKAGE_RTK8189ES_LOCAL=y
#BR2_PACKAGE_RTK8189ES_GIT_VERSION="8189es"
#BR2_PACKAGE_RTK8189ES_LOCAL_PATH="$(TOPDIR)/../hardware/aml-3.10/wifi/realtek/drivers/8189es"
#BR2_PACKAGE_RTK8723BS=y
#BR2_PACKAGE_RTK8723BS_LOCAL=y
#BR2_PACKAGE_RTK8723BS_GIT_VERSION="8723bs"
#BR2_PACKAGE_RTK8723BS_LOCAL_PATH="$(TOPDIR)/../hardware/aml-3.10/wifi/realtek/drivers/8723bs"
#BR2_PACKAGE_RTK8723AU=y
#BR2_PACKAGE_RTK8723AU_LOCAL=y
#BR2_PACKAGE_RTK8723AU_GIT_VERSION="8723au"
#BR2_PACKAGE_RTK8723AU_LOCAL_PATH="$(TOPDIR)/../hardware/aml-3.10/wifi/realtek/drivers/8723au"
#BR2_PACKAGE_RTK8723BU=y
#BR2_PACKAGE_RTK8723BU_LOCAL=y
#BR2_PACKAGE_RTK8723BU_GIT_VERSION="8723bu"
#BR2_PACKAGE_RTK8723BU_LOCAL_PATH="$(TOPDIR)/../hardware/aml-3.10/wifi/realtek/drivers/8723bu"
#BR2_PACKAGE_RTK8811AU=y
#BR2_PACKAGE_RTK8811AU_LOCAL=y
#BR2_PACKAGE_RTK8811AU_GIT_VERSION="8811au"
#BR2_PACKAGE_RTK8811AU_LOCAL_PATH="$(TOPDIR)/../hardware/aml-3.10/wifi/realtek/drivers/8811au"
#BR2_PACKAGE_RTK8812AU=y
#BR2_PACKAGE_RTK8812AU_LOCAL=y
#BR2_PACKAGE_RTK8812AU_GIT_VERSION="8812au"
#BR2_PACKAGE_RTK8812AU_LOCAL_PATH="$(TOPDIR)/../hardware/aml-3.10/wifi/realtek/drivers/8812au"
BR2_PACKAGE_BRCMAP6XXX=y
BR2_PACKAGE_BRCMAP6XXX_LOCAL=y
BR2_PACKAGE_BRCMAP6XXX_GIT_VERSION="ap6xxx"
BR2_PACKAGE_BRCMAP6XXX_LOCAL_PATH="$(TOPDIR)/../hardware/aml-3.10/wifi/broadcom/drivers/ap6xxx"
#BR2_PACKAGE_BRCMUSI=y
#BR2_PACKAGE_BRCMUSI_LOCAL=y
#BR2_PACKAGE_BRCMUSI_GIT_VERSION="kk-amlogic"
#BR2_PACKAGE_BRCMUSI_LOCAL_PATH="$(TOPDIR)/../hardware/aml-3.10/wifi/broadcom/drivers/usi"
BR2_PACKAGE_AML_TVIN=y
BR2_PACKAGE_AML_TVIN_LOCAL=y
BR2_PACKAGE_AML_TVIN_GIT_VERSION="amlogic-3.10-bringup"
BR2_PACKAGE_AML_TVIN_LOCAL_PATH="$(TOPDIR)/../hardware/tvin"
#BR2_PACKAGE_AML_PMU=y
#BR2_PACKAGE_AML_PMU_LOCAL=y
#BR2_PACKAGE_AML_PMU_GIT_VERSION="master"
#BR2_PACKAGE_AML_PMU_LOCAL_PATH="$(TOPDIR)/../hardware/aml-3.10/amlogic/pmu"
#BR2_PACKAGE_AML_TOUCH=y
#BR2_PACKAGE_AML_TOUCH_LOCAL=y
#BR2_PACKAGE_AML_TOUCH_GIT_VERSION="kk-amlogic"
#BR2_PACKAGE_AML_TOUCH_LOCAL_PATH="$(TOPDIR)/../hardware/aml-3.10/amlogic/touch"
BR2_PACKAGE_AML_NAND=y
BR2_PACKAGE_AML_NAND_LOCAL=y
BR2_PACKAGE_AML_NAND_VERSION="amlogic-nand"
BR2_PACKAGE_AML_NAND_LOCAL_PATH="$(TOPDIR)/../hardware/aml-3.10/amlogic/nand"
BR2_PACKAGE_AML_UTIL=y
BR2_TARGET_UBOOT=y
BR2_TARGET_UBOOT_CUSTOM_LOCAL=y
BR2_TARGET_UBOOT_CUSTOM_LOCAL_VERSION_VALUE="next"
BR2_TARGET_UBOOT_CUSTOM_LOCAL_LOCATION="$(TOPDIR)/../bootloader/uboot"
BR2_TARGET_UBOOT_PATCH=""
BR2_TARGET_UBOOT_BOARDNAME="m8b_m201_1G"
#BR2_PACKAGE_AML_UBOOT_CUSTOMER=y
#BR2_PACKAGE_AML_UBOOT_CUSTOMER_GIT_VERSION="2015-01-15-3e952b1815"
#BR2_PACKAGE_AML_UBOOT_CUSTOMER_GIT_REPO_URL="http://openlinux.amlogic.com:8000/download/ARM/u-boot"
BR2_TARGET_UBOOT_AMLOGIC=y
BR2_TARGET_USBTOOL_AMLOGIC=y
#Mali egl
BR2_PACKAGE_MESON_MALI=y
BR2_PACKAGE_PROVIDES_LIBEGL="meson-mali"
BR2_PACKAGE_PROVIDES_LIBGLES="meson-mali"
BR2_PACKAGE_HAS_LIBEGL_WAYLAND=y
BR2_PACKAGE_MESON_MALI_MODEL="m450"
BR2_PACKAGE_MESON_MALI_VERSION="r7p0"
BR2_PACKAGE_MESON_MALI_WAYLAND_EGL=y
#DRM, for wayland
BR2_PACKAGE_LIBDRM=y
BR2_PACKAGE_LIBDRM_HAS_ATOMIC=y
#Wayland
BR2_PACKAGE_WAYLAND=y
BR2_PACKAGE_WAYLAND_PROTOCOLS=y
BR2_PACKAGE_WESTON=y
BR2_PACKAGE_WESTON_FBDEV=y
BR2_PACKAGE_XKEYBOARD_CONFIG=y
BR2_PACKAGE_LIBPTHREAD_STUBS=y
BR2_PACKAGE_LIBINPUT=y
BR2_PACKAGE_LIBXKBCOMMON=y
BR2_PACKAGE_QT5_VERSION_5_6=y
BR2_PACKAGE_QT5WAYLAND=y
#EUDEV, for wayland
BR2_PACKAGE_EUDEV=y
BR2_PACKAGE_PROVIDES_UDEV="eudev"
BR2_PACKAGE_EUDEV_ENABLE_HWDB=y
BR2_PACKAGE_HAS_UDEV=y
BR2_PACKAGE_MTDEV=y
BR2_PACKAGE_LIBEVDEV=y
#Chromium app
BR2_PACKAGE_CHROMIUM=y
```
