## configs/mesongx_defconfig
```kconfig
BR2_aarch64=y
BR2_TOOLCHAIN_EXTERNAL=y
BR2_TARGET_GENERIC_GETTY_PORT="ttyS0"
BR2_TARGET_ROOTFS_CPIO=y
BR2_TARGET_ROOTFS_CPIO_UIMAGE=y
BR2_TARGET_ROOTFS_EXT2=y
# BR2_TARGET_ROOTFS_TAR is not set
```

## configs/mesongx_release_defconfig
```kconfig
BR2_aarch64=y
BR2_TOOLCHAIN_EXTERNAL=y
BR2_TARGET_GENERIC_GETTY_PORT="ttyS0"
#BR2_PACKAGE_AMAUDIO=y
#BR2_PACKAGE_AML_LIBS=y
#BR2_PACKAGE_ALSA_LIB=y
#BR2_PACKAGE_LIBSAMPLERATE=y
BR2_PACKAGE_ZLIB=y
BR2_TARGET_ROOTFS_CPIO=y
BR2_TARGET_ROOTFS_CPIO_UIMAGE=y
BR2_TARGET_ROOTFS_EXT2=y
# BR2_TARGET_ROOTFS_TAR is not set

#BR2_PACKAGE_MALI_EXAMPLES=y
#BR2_PACKAGE_GPU=y
#BR2_PACKAGE_GPU_LOCAL=y
#BR2_PACKAGE_GPU_STANDALONE=y
#BR2_PACKAGE_GPU_MODEL="dvalin"
#BR2_PACKAGE_GPU_VERSION="r9p0"
#BR2_PACKAGE_GPU_LOCAL_PATH="$(TOPDIR)/../hardware/aml-3.14/arm/gpu"
#Mali egl
#BR2_PACKAGE_MESON_MALI=y
#BR2_PACKAGE_PROVIDES_LIBEGL="meson-mali"
#BR2_PACKAGE_PROVIDES_LIBGLES="meson-mali"
#BR2_PACKAGE_MESON_MALI_MODEL="dvalin"
#BR2_PACKAGE_MESON_MALI_VERSION="r9p0"
#BR2_PACKAGE_FBDUMP=y
BR2_PACKAGE_AML_BRCM_BSA=n

#DRM
#BR2_PACKAGE_LIBDRM=y
```

## package/airplay2/Config.in
```kconfig
config BR2_PACKAGE_AIRPLAY2
	bool "Build AirPlay2 package"
    default n
    select BR2_PACKAGE_MDNSRESPONDER
    help
        airplay 2

config BR2_PACKAGE_AIRPLAY2_GIT_URL
    string "airplay2 source git url"
    default "ssh://scgit.amlogic.com:29418/airplay/airplayv2"
    depends on BR2_PACKAGE_AIRPLAY2

config BR2_PACKAGE_GPTP
    bool "Build GPTP"
    default n
    depends on BR2_PACKAGE_AIRPLAY2
    help
        https://github.com/AVnu/gptp
```

## package/alsaplayer/Config.in
```kconfig
config BR2_PACKAGE_ALSAPLAYER
	bool "alsaplayer"
	select BR2_PACKAGE_LIBVORBIS
	select BR2_PACKAGE_FLAC
	select BR2_PACKAGE_LIBSNDFILE
	help
		alsaplayer is a player for audio that it supports .mp3 .ogg .flac .wav CD file.
```

## package/aml_bdk_ca/Config.in
```kconfig
config BR2_PACKAGE_AML_BDK_CA
    bool "client-app"
    depends on BR2_LINUX_KERNEL
    help
        Trustzone client application
```

## package/aml_bdk_ta/Config.in
```kconfig
config BR2_PACKAGE_AML_BDK_TA
    bool "trusted-app"
    depends on BR2_LINUX_KERNEL
    help
        Trustzone trusted application
```

## package/aml_brcm_bsa/Config.in
```kconfig
config BR2_PACKAGE_AML_BRCM_BSA
    bool "broadcom bsa server and app"
    default y
    help
	broadcom bsa server and app

config BR2_AML_BRCM_BSA_MEM_REDUCTION
    bool "broadcom bsa mem reduction configure"
    help
    broadcom bsa mem reduction configure

config BR2_AML_BT_DSPC
    bool "bluetooth audio capture use libdspc"
    default y
    help
	bluetooth audio capture use libdspc
```

## package/aml_browser_toolchains/Config.in
```kconfig
menu "AML Browser Toolchains"
  source "package/aml_browser_toolchains/browser_toolchain_bison/Config.in"
  source "package/aml_browser_toolchains/browser_toolchain_depot_tools/Config.in"
  source "package/aml_browser_toolchains/browser_toolchain_gcc-linaro-aarch64/Config.in"
  source "package/aml_browser_toolchains/browser_toolchain_gcc-linaro-armeabihf/Config.in"
endmenu
```

## package/aml_customer/Config.in
```kconfig
config BR2_PACKAGE_AML_CUSTOMER
	bool "amlogic customer git repo"
	help
	  The git of amlogic customer git repo

config BR2_PACKAGE_AML_CUSTOMER_VERSION
	string "amlogic customer branch" 
	depends on BR2_PACKAGE_AML_CUSTOMER
	help
	  the branch of amlogic customer

config BR2_PACKAGE_AML_CUSTOMER_GIT_URL
	string "amlogic customer git repo url"
	depends on BR2_PACKAGE_AML_CUSTOMER
	help
	  the URL of amlogic customer git repo

config BR2_PACKAGE_AML_STRIP_KERNEL
	bool  "Strip kernel size by disable addon options"
	default n
	help
	  Allow project to disable additional kernel options to decrease size

if BR2_PACKAGE_AML_STRIP_KERNEL

config BR2_PACKAGE_AML_STRIP_KERNEL_DISABLE_OPT_LIST
	string  "Add-on disabled kernel options, separate by whitespace"
	default ""
	help
	  Please add project specified disabled kernel options which is not covered by buildroot by default

config BR2_PACKAGE_AML_STRIP_KERNEL_ENABLE_OPT_LIST
	string  "Add-on enable kernel options, separate by whitespace"
	default ""
	help
	  Please add project specified enable kernel options which is not covered by buildroot by default

config BR2_PACKAGE_AML_STRIP_KERNEL_SET_OPT_LIST
	string  "Add-on kernel options new value, separate by whitespace"
	default ""
	help
	  Please add project specified new kernel options value which is not covered by buildroot by default
endif

config BR2_PACKAGE_AML_WITH_SYSTEM_CONTROL
	bool  "Have source code of system_control"
	default n
	help
	  Only eanble it when project have source code of system_control

config BR2_PACKAGE_AML_WITH_HALAUDIO
	bool  "Have source code of aml_halaudio"
	default n
	help
	  Only eanble it when project have source code of aml_halaudio

config BR2_PACKAGE_AML_WITH_AUDIOSERVICE
	bool  "Have source code of audioservice"
	default n
	help
	  Only eanble it when project have source code of audioservice

config BR2_PACKAGE_AML_WITH_EXTERNAL_PLATINUM
	bool  "Have source code of external platinum"
	default n
	help
	  Only eanble it when project have source code of external platinum
```

## package/aml_hifi4/Config.in
```kconfig
config BR2_PACKAGE_AML_HIFI4
	bool "AML hifi4 DSP"
	help
	  Amlogic HiFi4 DSP

config BR2_PACKAGE_AML_HIFI4_BUILD_OPTION
    string "AML hifi4 build option"
    depends on BR2_PACKAGE_AML_HIFI4
    help
      the branch of amlogic customer
```

## package/aml_libgdc/Config.in
```kconfig
config BR2_PACKAGE_AML_LIBGDC
    bool "GDC library"
    select BR2_PACKAGE_AML_LIBION
    help
        Support AML GDC library
```

## package/aml_libge2d/Config.in
```kconfig
config BR2_PACKAGE_AML_LIBGE2D
    bool "GE2D library"
    select BR2_PACKAGE_AML_LIBION
    help
        Support AML GE2D library
```

## package/aml_libion/Config.in
```kconfig
config BR2_PACKAGE_AML_LIBION
    bool "aml_libion"
    help
      amlogic libion
```

## package/aml_nn_detect/Config.in
```kconfig
config BR2_PACKAGE_AML_NN_DETECT
    bool "aml nn_detect library"
    help
        Support nn detection
        depends on BR2_PACKAGE_NPU
```

## package/aml_nn_detect_library/aml_nn_detect/Config.in
```kconfig
config BR2_PACKAGE_AML_NN_DETECT
    bool "aml nn_detect"
    help
        Support nn detection base library

if BR2_PACKAGE_AML_NN_DETECT
source "package/aml_nn_detect_library/aml_nn_detect_mtcnn_v1/Config.in"
source "package/aml_nn_detect_library/aml_nn_detect_yolo_v2/Config.in"
source "package/aml_nn_detect_library/aml_nn_detect_yolo_v3/Config.in"
source "package/aml_nn_detect_library/aml_nn_detect_yoloface/Config.in"
source "package/aml_nn_detect_library/aml_nn_facenet/Config.in"
endif
```

## package/aml_nn_detect_library/aml_nn_insightface/Config.in
```kconfig
config BR2_PACKAGE_AML_NN_INSIGHTFACE
    bool "aml nn insightface library"
    depends on BR2_PACKAGE_NPU
    help
        Support nn insightface library
```

## package/aml_tvserver/Config.in
```kconfig
config BR2_PACKAGE_AML_TVSERVER
        bool "aml_tvserver"
        help
          amlogic tv library and bin.

          http://openlinux.amlogic.com
```

## package/aml_uboot_toolchain-arc/Config.in
```kconfig
config BR2_PACKAGE_AML_UBOOT_TOOLCHAIN_ARC
    bool "Amlogic Uboot arc toolchain"
    default n
    help
	amlogic m8 soc uboot compile toolchain
```
